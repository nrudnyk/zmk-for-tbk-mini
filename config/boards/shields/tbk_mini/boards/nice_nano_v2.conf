## config/boards/shields/tbk_mini/boards/nice_nano_v2.conf
```kconfig
CONFIG_ZMK_RGB_UNDERGLOW=y
CONFIG_WS2812_STRIP=y

CONFIG_ZMK_RGB_UNDERGLOW_ON_START=y
CONFIG_ZMK_RGB_UNDERGLOW_AUTO_OFF_IDLE=y
CONFIG_ZMK_RGB_UNDERGLOW_BRT_START=75
# Spectrum
CONFIG_ZMK_RGB_UNDERGLOW_EFF_START=2
CONFIG_ZMK_RGB_UNDERGLOW_BRT_MIN=0
CONFIG_ZMK_RGB_UNDERGLOW_BRT_MAX=75 
```
